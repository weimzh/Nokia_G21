## bsp/kernel/kernel4.14/drivers/input/fingerprint/Kconfig
```kconfig
#
#Fingerprint
#
menu "Fingerprint support"
	depends on INPUT

config INPUT_FINGERPRINT_SUPPORT
	bool "Unisoc Fingerprint"
	default n
	help
	  Fingerprint unisoc driver enable/disable
	  in the kernel.Say Y here if you want to
	  use unisoc fingerprint driver,fingerprint
	  driver will support fingerprint function

config CHIPONE_FINGERPRINT
	bool "chipone Fingerprint"
	default n
	help
	  chipone fingerprint 7332 device.

endmenu
```

## bsp/kernel/kernel4.14/drivers/input/misc/sar/Kconfig
```kconfig
#
# Input misc drivers configuration
#
config CAPSENSE_HX9031A
	tristate "NanJingTianYiHeXin HX9031A or HX9023E SAR SENSOR"
	depends on I2C
	default y
```

## bsp/kernel/kernel4.14/drivers/nfc/Kconfig
```kconfig
#
# Near Field Communication (NFC) devices
#

menu "Near Field Communication (NFC) devices"
	depends on NFC

config NFC_TRF7970A
	tristate "Texas Instruments TRF7970a NFC driver"
	depends on SPI && NFC_DIGITAL && GPIOLIB
	help
	  This option enables the NFC driver for Texas Instruments' TRF7970a
	  device. Such device supports 5 different protocols: ISO14443A,
	  ISO14443B, FeLiCa, ISO15693 and ISO18000-3.

	  Say Y here to compile support for TRF7970a into the kernel or
	  say M  to compile it as a module. The module will be called
	  trf7970a.ko.

config NFC_MEI_PHY
	tristate "MEI bus NFC device support"
	depends on INTEL_MEI && NFC_HCI
	help
	  This adds support to use an mei bus nfc device. Select this if you
	  will use an HCI NFC driver for an NFC chip connected behind an
	  Intel's Management Engine chip.

	  If unsure, say N.

config NFC_SIM
	tristate "NFC hardware simulator driver"
	depends on NFC_DIGITAL
	help
	  This driver declares two virtual NFC devices supporting NFC-DEP
	  protocol. An LLCP connection can be established between them and
	  all packets sent from one device is sent back to the other, acting as
	  loopback devices.

	  If unsure, say N.

config NFC_PORT100
	tristate "Sony NFC Port-100 Series USB device support"
	depends on USB
	depends on NFC_DIGITAL
	help
	  This adds support for Sony Port-100 chip based USB devices such as the
	  RC-S380 dongle.

	  If unsure, say N.

config NXP_PN557
    tristate "NFC driver solution - NXPMicroelectronics PN533 NFC Controller Driver"
    #default n
    depends on I2C
    help
      STMicroelectronics PN533 Near Field Communication controller support.
      PN533 is standalone NFC and PN533 is combined with secure element.
      If configures to be y, means devices supports NFC functionality.
      If configures to be n, means devices doesn't support NFC functionality.

config NXP_NFC_PN8XT
        bool "Nxp NFC pn8xt Controller"
        ---help---
          You'll have to say Y if your computer contains an pn8xt I2C device that
          you want to use under Linux.

          You can say N here if you don't have any pn8xt I2C connected to your computer.

source "drivers/nfc/fdp/Kconfig"
source "drivers/nfc/pn544/Kconfig"
source "drivers/nfc/pn533/Kconfig"
source "drivers/nfc/microread/Kconfig"
source "drivers/nfc/nfcmrvl/Kconfig"
source "drivers/nfc/st21nfca/Kconfig"
source "drivers/nfc/st-nci/Kconfig"
source "drivers/nfc/nxp-nci/Kconfig"
source "drivers/nfc/s3fwrn5/Kconfig"
source "drivers/nfc/st95hf/Kconfig"
source "drivers/nfc/pn557/Kconfig"
endmenu
```
